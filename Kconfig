## Kconfig
```kconfig
# Sensor data simulator
#
# Copyright (c) 2019 Nordic Semiconductor
#
# SPDX-License-Identifier: LicenseRef-Nordic-5-Clause
#

menuconfig PMW3610_ALT
  bool "PMW3610 mouse optical sensor"
  select SPI
  depends on INPUT
  depends on DT_HAS_PIXART_PMW3610_ALT_ENABLED
  help
      Enable PMW3610 mouse optical sensor.

if PMW3610_ALT

config INPUT_PMW3610_INIT_PRIORITY
    int "PMW3610 initialization priority"
    default INPUT_INIT_PRIORITY

config PMW3610_ALT_SWAP_XY
  bool "Swap the X/Y axis of PMW3610 sensor"

config PMW3610_ALT_INVERT_X
  bool "Invert the X axis of PMW3610 sensor"

config PMW3610_ALT_INVERT_Y
  bool "Invert the Y axis of PMW3610 sensor"

config PMW3610_ALT_ORIENTATION_180
  bool "Rotate sensor 180 degrees (invert both X and Y axes)"
  help
    Equivalent to CONFIG_PMW3610_ORIENTATION_180 in the original driver.
    When enabled, both X and Y axes are inverted regardless of the
    invert-x / invert-y device tree properties.

config PMW3610_ALT_CPI_DIVIDOR
  int "CPI divisor"
  default 1
  range 1 12
  help
    Divides the CPI value set in the device tree node.
    1 means no division (default).

config PMW3610_ALT_SCROLL_TICK
  int "Scroll tick - accumulated delta before reporting one scroll unit"
  default 20
  range 1 255
  help
    Number of sensor delta counts to accumulate before emitting one
    WHEEL / HWHEEL scroll event. Higher value = slower scroll.

config PMW3610_ALT_INVERT_SCROLL_X
  bool "Invert horizontal scroll (HWHEEL) direction"

config PMW3610_ALT_INVERT_SCROLL_Y
  bool "Invert vertical scroll (WHEEL) direction"

config PMW3610_ALT_SNIPE_CPI_DIVIDOR
  int "CPI divisor applied in snipe-layers"
  default 4
  range 1 12
  help
    Divides cursor movement in snipe-layers before reporting.
    Remainders are accumulated and carried over between reports.
    Higher value = slower, more precise cursor.

config PMW3610_ALT_INIT_POWER_UP_EXTRA_DELAY_MS
  int "Extra power up init delay (ms)"
  default 0


config PMW3610_ALT_SMART_ALGORITHM
  bool "Enable an algorithm of PMW3610 to enhance surface coverage"
  default y

config PMW3610_ALT_RUN_DOWNSHIFT_TIME_MS
    int "PMW3610's default RUN mode downshift time"
    default 128
    range 13 3264

config PMW3610_ALT_REST1_DOWNSHIFT_TIME_MS
    int "PMW3610's default REST1 mode downshift time"
    default 5000

config PMW3610_ALT_REST2_DOWNSHIFT_TIME_MS
    int "PMW3610's default REST2 mode downshift time"
    default 17000

config PMW3610_ALT_REST1_SAMPLE_TIME_MS
    int "PMW3610's sample time in REST1 stage"
    default 40

config PMW3610_ALT_REST2_SAMPLE_TIME_MS
    int "PMW3610's sample time in REST2 stage"
    default 100

config PMW3610_ALT_REST3_SAMPLE_TIME_MS
    int "PMW3610's sample time in REST3 stage"
    default 500

config PMW3610_ALT_MOVEMENT_THRESHOLD
    int "Minimum movement threshold to report"
    default 0

module = PMW3610_ALT
module-str = PMW3610_ALT
source "${ZEPHYR_BASE}/subsys/logging/Kconfig.template.log_config"

endif #PMW3610_ALT
```

## dts/bindings/pixart,pmw3610-alt.yml
```yaml
description: |
  Sensor driver for the pixart PMW3610 mouse sensor 

compatible: "pixart,pmw3610-alt"

include: spi-device.yaml

properties:
  irq-gpios:
    type: phandle-array
    required: true
  cpi:
    type: int
    default: 600
    description: "CPI value (Range: 200 - 3200, Step: 200)"
  swap-xy:
    type: boolean
  invert-x:
    type: boolean
  invert-y:
    type: boolean
  evt-type:
    type: int
    required: true
  x-input-code:
    type: int
    required: true
  y-input-code:
    type: int
    required: true
  force-awake:
    type: boolean
  force-awake-4ms-mode:
    type: boolean
  scroll-layers:
    type: array
    description: |
      Layer numbers that activate scroll mode.
      Driver emits WHEEL/HWHEEL instead of REL_X/REL_Y.
      Speed controlled by CONFIG_PMW3610_ALT_SCROLL_TICK.
      Example: scroll-layers = <5>;
  snipe-layers:
    type: array
    description: |
      Layer numbers that activate snipe (precision) mode.
      Driver divides cursor movement by CONFIG_PMW3610_ALT_SNIPE_CPI_DIVIDOR,
      with remainder carry-over for lossless precision.
      Example: snipe-layers = <15>;
  arrows-profiles:
    type: array
    description: |
      レイヤーごとのキーマッピング。
      5個ずつのセットで記述: [layer, key_up, key_down, key_left, key_right]
      複数レイヤーを並べて書ける。

      Linux keycode早見表:
        矢印キー  UP=103 DOWN=108 LEFT=105 RIGHT=106
        PageUp/Down    104 / 109
        Home / End     102 / 107
        Enter          28
        Tab            15
        Escape         1

      例:
        arrows-profiles = <
            3   103 108 105 106   /* layer 3: 矢印キー */
            4   104 109 102 107   /* layer 4: PageUp/Down Home/End */
        >;
  numpad-layers:
    type: array
    description: |
      Layer numbers that activate numpad 2-stroke input mode.
      Example: numpad-layers = <2>;
  numpad-tick:
    type: int
    default: 15
    description: |
      Stroke detection threshold (raw delta). Default 15.
      小さいほど敏感、大きいほど大きく動かさないと反応しない。
  numpad-timeout-ms:
    type: int
    default: 1000
    description: |
      2ストローク目の入力待ちタイムアウト(ms)。
      この時間内に2ストローク目が来なければリセット。Default 1000ms。

  arrows-tick:
    type: int
    default: 10
    description: |
      Raw delta threshold to fire one arrow key event. Default 10.
  arrows-diagonal:
    type: boolean
    description: |
      Allow diagonal arrow key output. When enabled, both X and Y axes can
      fire simultaneously. Default off (dominant axis only).
  arrows-accel:
    type: boolean
    description: |
      Enable acceleration: faster trackball movement reduces the effective
      tick, causing more rapid key firing.
  arrows-accel-max-div:
    type: int
    default: 4
    description: |
      Maximum divisor applied to tick at high speed. Default 4 (tick/4 at peak).
  arrows-accel-threshold:
    type: int
    default: 20
    description: |
      Raw delta magnitude at which max acceleration is reached. Default 20.
  arrows-repeat-delay-ms:
    type: int
    default: 300
    description: |
      Delay before auto-repeat starts when holding a direction (ms).
      Set to 0 to disable auto-repeat. Default 300.
  arrows-repeat-rate-ms:
    type: int
    default: 50
    description: |
      Interval between auto-repeat key events (ms). Default 50.
  scroll-inertia:
    type: boolean
    description: Enable inertia (momentum) scrolling.
  scroll-inertia-decay:
    type: int
    default: 75
    description: |
      Decay % applied when speed is slow (scroll-inertia-slow-spd or below).
      Lower = stops faster. Default: 75.
  scroll-inertia-decay-fast:
    type: int
    default: 92
    description: |
      Decay % applied when speed is fast (scroll-inertia-fast-spd or above).
      Higher = longer glide on fast flicks. Default: 92.
  scroll-inertia-slow-spd:
    type: int
    default: 2
    description: |
      Speed (scroll units/tick) at or below which slow decay applies. Default: 2.
  scroll-inertia-fast-spd:
    type: int
    default: 6
    description: |
      Speed (scroll units/tick) at or above which fast decay applies. Default: 6.
  scroll-inertia-tick-ms:
    type: int
    default: 16
    description: |
      Timer interval for inertia decay in ms. Default 16ms (~60fps).
  scroll-flick-threshold:
    type: int
    default: 6
    description: |
      4-sample average raw delta needed to trigger flick detection.
      Lower = more sensitive. Default: 6.
  scroll-flick-boost:
    type: int
    default: 512
    description: |
      Velocity multiplier applied on flick, in fixed-point *256.
      512 = 2x boost, 384 = 1.5x, 256 = no boost. Default: 512.
  scroll-accel:
    type: boolean
    description: |
      Enable scroll acceleration: amplify scroll delta based on ball speed.
      Slow movement = 1x, fast movement = scroll-accel-max-mult x.
  scroll-accel-max-mult:
    type: int
    default: 4
    description: |
      Maximum scroll multiplier at high speed. Default 4 (4x at threshold).
  scroll-accel-threshold:
    type: int
    default: 20
    description: |
      Raw delta speed at which maximum multiplier is reached. Default 20.
      小さいほど少ない動きで最大倍率に達する。
```

## dts/bindings/zmk,behavior-arrows-alt.yml
```yaml
description: Momentary layer activation with arrows-alt mode for trackball

compatible: "zmk,behavior-arrows-alt"

properties:
  "#binding-cells":
    type: int
    const: 1
```
